#include <Wire.h>
#include <Adafruit_GFX.h>
#include "time.h"
#include <Adafruit_SSD1306.h>
#include <WiFi.h>
#include <string.h>
#include <WebServer.h>
#include <EEPROM.h>
#define EEPROM_SIZE 256

#define SDA_PIN 21
#define SCL_PIN 10
#define TOUCH_PIN 7

#define STANDARD_SCREEN_OFFSET_X 16
#define STANDARD_SCREEN_OFFSET_Y 8
#define BLINK_PERIOD 3500
#define BLINK_TIME 175

#define FACTOR_DECREASE_PERIOD 3600000
#define PETTING_DECREASE_RATE 0.90
#define HUNGER_DECREASE_RATE 0.80
#define CLEAN_DECREASE_RATE 0.95
#define ATTENTION_DECREASE_RATE 0.70

const uint32_t FACTORS_SIGNATURE = 0x52414646;

const uint32_t CONFIG_SIGNATURE = 0x5241464E; // 'RAFN'

// Конфиг: имя + флаг, что тамагочи уже вылупился
struct PetConfig
{
  char name[16];       // до 15 символов UTF-8 + '\0'
  bool hatched;        // 0 - яйцо, 1 - вылупился
  uint8_t reserved[3]; // выравнивание / запас
};

void saveConfig(const PetConfig &cfg)
{
  int addr = 64; // отдельный блок EEPROM
  uint32_t sig = CONFIG_SIGNATURE;
  EEPROM.put(addr, sig);
  addr += sizeof(sig);
  EEPROM.put(addr, cfg);
  EEPROM.commit();
}

bool hasSavedConfig()
{
  int addr = 64;
  uint32_t sig;
  EEPROM.get(addr, sig);
  return (sig == CONFIG_SIGNATURE);
}

void loadConfig(PetConfig &cfg)
{
  int addr = 64 + sizeof(CONFIG_SIGNATURE);
  EEPROM.get(addr, cfg);
}

typedef struct Factors
{
  unsigned int hunger, petting, attention, clean;
} Factors;

void clearEEPROM()
{
  EEPROM.begin(EEPROM_SIZE);
  for (int i = 0; i < EEPROM_SIZE; i++)
  {
    EEPROM.write(i, 0xFF);
  }
  EEPROM.commit();
}

void saveFactors(Factors &f)
{
  int addr = 0;

  EEPROM.put(addr, FACTORS_SIGNATURE);
  addr += sizeof(FACTORS_SIGNATURE);

  EEPROM.put(addr, f);
  EEPROM.commit();
}

bool hasSavedFactors()
{
  uint32_t sig;
  EEPROM.get(0, sig);
  return (sig == FACTORS_SIGNATURE);
}

void loadFactors(Factors &f)
{
  int addr = 0;
  addr += sizeof(FACTORS_SIGNATURE);
  EEPROM.get(addr, f);
}

unsigned int claculateOverall(Factors f);

class Panel
{
private:
  Factors *f;
  const char *petName;

  // ----- Обычная линия -----
  String line(const char *id, const char *name, unsigned int value)
  {
    const char *cls =
        (value < 30) ? "low" : (value <= 70) ? "mid"
                                             : "high";

    char buf[650];
    snprintf(buf, sizeof(buf),
             R"rawliteral(
            <div class="factor">
                <div class="top">
                    <span class="name">%s</span>
                    <span class="value" id="%sValue">%u%%</span>
                </div>
                <div class="bar %s" id="%sBar">
                    <div class="fill" id="%sFill" style="width:%u%%"></div>
                </div>
            </div>
            )rawliteral",
             name, id, value,
             cls, id,
             id, value);

    return String(buf);
  }

  // ----- Общая линия -----
  String overallLine(unsigned int value)
  {
    const char *cls = (value < 30) ? "factor overall low" : "factor overall";

    char buf[800];
    snprintf(buf, sizeof(buf),
             R"rawliteral(
            <div class="%s" id="overallCard">
                <div class="overall-label">Общее состояние</div>
                <div class="top">
                    <span class="name">Raf</span>
                    <span class="value" id="overallValue">%u%%</span>
                </div>
                <div class="bar">
                    <div class="fill overall-fill" id="overallFill" style="width:%u%%"></div>
                </div>
            </div>
            )rawliteral",
             cls, value, value);

    return String(buf);
  }

public:
  Panel(Factors *ptr, const char *name = nullptr) : f(ptr), petName(name) {}

  void setName(const char *name) { petName = name; }

  // ====== ОСНОВНАЯ СТРАНИЦА ======
  String render()
  {
    String page = R"rawliteral(
<!DOCTYPE html>
<html>
<head>
<meta charset="UTF-8" name="viewport" content="width=device-width, initial-scale=1.0">
<title>Raf</title>

<style>
    :root {
        --bg1: #fde1f3;
        --bg2: #f9e4ff;
        --bg3: #fef6ff;

        --card: #ffffff;
        --card-soft: #fff7ff;

        --green: #4ade80;
        --green-soft: #bbf7d0;

        --orange: #fb923c;
        --orange-soft: #fed7aa;

        --red: #f87171;
        --red-soft: #fecaca;

        --purple: #d946ef;

        --text-main: #374151;
        --text-soft: #6b7280;
    }

    body {
        background: linear-gradient(180deg, var(--bg1), var(--bg2), var(--bg3));
        font-family: "Arial";
        padding: 22px 16px;
        text-align: center;
        color: var(--text-main);
    }

    /* ======= ШАПКА ======= */

    .header {
        max-width: 420px;
        margin: 0 auto 20px;
        padding: 12px 18px 18px;
        border-radius: 22px;
        background: linear-gradient(135deg, #ffffffdd, #ffe9ffdd);
        backdrop-filter: blur(10px);
        box-shadow: 0 12px 28px rgba(0,0,0,0.06);
        border: 1px solid rgba(255,255,255,0.9);
        position: relative;
        overflow: hidden;
        text-align: left;
    }

    .header::before {
        content: "";
        position: absolute;
        right: -40px;
        top: -40px;
        width: 120px;
        height: 120px;
        border-radius: 999px;
        background: radial-gradient(circle at 30% 30%, #f9a8ff, #e879f9);
        opacity: 0.55;
        filter: blur(2px);
    }

    .header-inner {
        position: relative;
        z-index: 1;
    }

    .badge {
        display: inline-flex;
        align-items: center;
        gap: 6px;
        padding: 4px 10px 4px 6px;
        border-radius: 999px;
        background: rgba(255,255,255,0.9);
        border: 1px solid rgba(216,180,254,0.7);
        font-size: 11px;
        font-weight: 600;
        color: var(--text-soft);
        text-transform: uppercase;
        letter-spacing: 0.11em;
        margin-bottom: 8px;
    }

    .badge-dot {
        width: 7px;
        height: 7px;
        border-radius: 50%;
        background: #22c55e;
        box-shadow: 0 0 10px rgba(34,197,94,0.8);
    }

    h2 {
        font-size: 24px;
        font-weight: 800;
        color: var(--purple);
        margin: 2px 0 4px;
        text-shadow: 0 0 8px rgba(217,70,239,0.22);
    }

    .subtitle {
        font-size: 13px;
        line-height: 1.35;
    }

    .subtitle div {
        color: var(--text-soft);
        font-size: 13px;
    }

    .card-wrapper {
        max-width: 420px;
        margin: 0 auto;
    }

    /* ===== Блоки ===== */
    .factor {
        background: var(--card);
        border-radius: 18px;
        padding: 14px;
        margin: 10px auto;
        width: 92%;
        max-width: 420px;
        border: 1px solid #f6d8f8;
        box-shadow: 0 4px 12px rgba(0,0,0,0.06);
    }

    .factor.overall {
        border-radius: 20px;
        padding: 18px;
        margin-bottom: 18px;
        background: var(--card-soft);
        border: 2px solid #f3a7ff;
        box-shadow: 0 0 18px rgba(243,167,255,0.5);
        animation: heartPulse 2.2s infinite ease-in-out;
        position: relative;
        overflow: hidden;
    }

    .factor.overall.low {
        border-color: #f87171;
        box-shadow: 0 0 18px rgba(248,113,113,0.7);
        animation: heartPulseRed 1.6s infinite ease-in-out;
    }

    @keyframes heartPulse { 
        0%, 100% { transform: scale(1); }
        50% { transform: scale(1.015); }
    }
    @keyframes heartPulseRed {
        0%, 100% { transform: scale(1); }
        50% { transform: scale(1.03); }
    }

    .overall-label {
        color: var(--purple);
        font-size: 12px;
        text-align: left;
        margin-bottom: 4px;
        font-weight: 700;
        letter-spacing: 0.06em;
        text-transform: uppercase;
    }

    .top {
        display: flex;
        justify-content: space-between;
        margin-bottom: 6px;
        font-size: 16px;
    }

    .name {
        font-weight: 600;
    }

    .value {
        font-weight: 700;
        color: var(--purple);
    }

    .bar {
        height: 20px;
        border-radius: 999px;
        overflow: hidden;
        background: #fff0fa;
        border: 1px solid #f3d1f5;
    }

    .fill { height: 100%; transition: width 0.35s ease-out; }

    .bar.low .fill {
        background: linear-gradient(90deg, var(--red-soft), var(--red));
    }
    .bar.mid .fill {
        background: linear-gradient(90deg, var(--orange-soft), var(--orange));
    }
    .bar.high .fill {
        background: linear-gradient(90deg, var(--green-soft), var(--green));
    }

    .overall-fill {
        background: linear-gradient(90deg, #f9a8ff, #e879f9);
    }

    .btn-row {
        margin-top: 18px;
        display: flex;
        gap: 12px;
        width: 92%;
        max-width: 420px;
        margin-left: auto;
        margin-right: auto;
    }

    .btn {
        flex: 1;
        padding: 12px;
        border-radius: 999px;
        border: none;
        font-size: 15px;
        font-weight: 700;
        cursor: pointer;
        color: white;
        transition: 0.12s ease-out;
    }

    .btn-feed {
        background: linear-gradient(135deg, #f68989, #f35db3);
    }

    .btn-clean {
        background: linear-gradient(135deg, #4ade80, #22c55e);
    }

    .btn:hover { transform: translateY(-2px); }
    .btn:active { transform: scale(0.97); }

    #toast {
        position: fixed;
        bottom: 60px;
        left: 50%;
        transform: translateX(-50%) translateY(40px);
        background: #ffffffee;
        backdrop-filter: blur(6px);
        padding: 14px 22px;
        border-radius: 14px;
        font-size: 15px;
        font-weight: 700;
        color: var(--purple);
        box-shadow: 0 8px 24px rgba(0,0,0,0.08);
        opacity: 0;
        transition: all 0.35s ease;
        pointer-events: none;
        z-index: 9999;
    }

    @media (max-height: 480px) {
        #toast { bottom: 50px; }
    }

    #toast.show {
        opacity: 1;
        transform: translateX(-50%) translateY(0px);
    }
</style>

<script>
    function toast(msg) {
        const t = document.getElementById("toast");
        t.innerText = msg;
        t.classList.add("show");
        setTimeout(() => t.classList.remove("show"), 10000);
    }

    function send(endpoint, message) {
        toast(message);
        fetch(endpoint).then(() => {
            setTimeout(() => location.reload(), 600);
        });
    }

    function refresh() {
        fetch('/status')
            .then(r => r.json())
            .then(data => {
                const ids = ["hunger","petting","attention","clean"];
                for (let id of ids) {
                    const v = data[id];
                    document.getElementById(id+"Value").innerText = v + "%";
                    document.getElementById(id+"Fill").style.width = v + "%";

                    const bar = document.getElementById(id+"Bar");
                    bar.classList.remove("low","mid","high");
                    bar.classList.add(v < 30 ? "low" : (v <= 70 ? "mid" : "high"));
                }

                const overall = Math.round(
                    (data.hunger + data.petting + data.attention + data.clean) / 4
                );

                document.getElementById("overallValue").innerText = overall + "%";
                document.getElementById("overallFill").style.width = overall + "%";

                document.getElementById("overallCard")
                    .classList.toggle("low", overall < 30);
            });
    }

    setInterval(refresh, 1200);
</script>
</head>

<body>

<div class="header">
    <div class="header-inner">
        <div class="badge">
            <span>Панель управления</span>
        </div>

        <h2>Я люблю тебя, Яна. -L</h2>

        <div class="subtitle">
            <div>Небольшой уголок, где можно следить за его состоянием и вовремя заботиться.</div>
            <div>Он очень ценит твою заботу и я тожеее ❤️</div>
        </div>
    </div>
</div>

<div class="card-wrapper">
)rawliteral";

    unsigned int overall = claculateOverall(*f);
    page += overallLine(overall);

    page += line("hunger", "Сытость", f->hunger);
    page += line("petting", "Ласка", f->petting);
    page += line("attention", "Внимание", f->attention);
    page += line("clean", "Чистота", f->clean);

    page += R"rawliteral(
    <div id="toast"></div>

    <div class="btn-row">
        <button class="btn btn-feed" onclick="send('/feed','Raf кушает...')">
            Покормить
        </button>
        <button class="btn btn-clean" onclick="send('/clean','Raf чистится...')">
            Почистить
        </button>
    </div>
</div>

</body>
</html>
)rawliteral";

    const char *p = (petName && petName[0]) ? petName : "Raf";
    page.replace("Raf", p);
    return page;
  }

  // ====== СТРАНИЦА ЯЙЦА В ТОМ ЖЕ СТИЛЕ ======
  String renderEgg(int clickCount)
  {
    String page = R"rawliteral(
<!DOCTYPE html>
<html>
<head>
<meta charset="UTF-8" name="viewport" content="width=device-width, initial-scale=1.0">
<title>Raf — egg</title>

<style>
    :root {
        --bg1: #fde1f3;
        --bg2: #f9e4ff;
        --bg3: #fef6ff;

        --card: #ffffff;
        --card-soft: #fff7ff;

        --purple: #d946ef;
        --purple-soft: #e879f9;

        --text-main: #374151;
        --text-soft: #6b7280;
    }

    body {
        background: linear-gradient(180deg, var(--bg1), var(--bg2), var(--bg3));
        font-family: "Arial";
        padding: 22px 16px;
        text-align: center;
        color: var(--text-main);
    }

    .header {
        max-width: 420px;
        margin: 0 auto 20px;
        padding: 12px 18px 18px;
        border-radius: 22px;
        background: linear-gradient(135deg, #ffffffdd, #ffe9ffdd);
        backdrop-filter: blur(10px);
        box-shadow: 0 12px 28px rgba(0,0,0,0.06);
        border: 1px solid rgba(255,255,255,0.9);
        position: relative;
        overflow: hidden;
        text-align: left;
    }

    .header::before {
        content: "";
        position: absolute;
        right: -40px;
        top: -40px;
        width: 120px;
        height: 120px;
        border-radius: 999px;
        background: radial-gradient(circle at 30% 30%, #f9a8ff, #e879f9);
        opacity: 0.55;
        filter: blur(2px);
    }

    .header-inner {
        position: relative;
        z-index: 1;
    }

    .badge {
        display: inline-flex;
        align-items: center;
        gap: 6px;
        padding: 4px 10px 4px 6px;
        border-radius: 999px;
        background: rgba(255,255,255,0.9);
        border: 1px solid rgba(216,180,254,0.7);
        font-size: 11px;
        font-weight: 600;
        color: var(--text-soft);
        text-transform: uppercase;
        letter-spacing: 0.11em;
        margin-bottom: 8px;
    }

    h2 {
        font-size: 24px;
        font-weight: 800;
        color: var(--purple);
        margin: 2px 0 4px;
        text-shadow: 0 0 8px rgba(217,70,239,0.22);
    }

    .subtitle {
        font-size: 13px;
        line-height: 1.35;
    }

    .subtitle div {
        color: var(--text-soft);
        font-size: 13px;
    }

    .page-card {
        max-width: 420px;
        margin: 0 auto;
        background: var(--card);
        border-radius: 22px;
        padding: 18px 16px 20px;
        box-shadow: 0 10px 24px rgba(0,0,0,0.08);
        border: 1px solid #f6d8f8;
    }

    .egg-wrapper{
        display:flex;
        flex-direction:column;
        align-items:center;
        gap:12px;
        margin-top:4px;

        /* чтобы тень позиционировалась относительно этого блока */
        position: relative;
        padding-bottom: 32px; /* место под тень */
    }

    /* ЯЙЦО */
    .egg{
        width:170px;
        height:210px;
        border-radius:50% 50% 45% 45%;
        background:
            radial-gradient(circle at 20% 15%, #ffffff, #fef3ff 35%, transparent 65%),
            radial-gradient(circle at 70% 80%, #ffe4f5, #f3c4ff 55%, #e3c7ff 100%);
        border:4px solid var(--purple);
        box-shadow:
            0 18px 40px rgba(0,0,0,0.12),
            0 0 18px rgba(217,70,239,0.35),
            0 0 40px rgba(248,113,255,0.25);
        position:relative;
        cursor:pointer;
        transition:transform .16s ease, box-shadow .16s ease;
        animation: float 2.6s ease-in-out infinite;
        z-index: 2; /* яйцо над тенью */
    }
    .egg:hover{
        transform:translateY(-4px) scale(1.02);
        box-shadow:
            0 22px 46px rgba(0,0,0,0.14),
            0 0 24px rgba(217,70,239,0.4);
    }
    .egg:active{
        transform:translateY(2px) scale(.97);
    }

    @keyframes float {
        0%,100% { transform: translateY(0); }
        50%     { transform: translateY(-6px); }
    }

    .egg-shine{
        position:absolute;top:14%;left:12%;
        width:40%;height:26%;
        border-radius:50%;
        background:radial-gradient(circle at 30% 30%, #fff, transparent 70%);
        opacity:.9;
    }

    /* ИСПРАВЛЕННАЯ НИЖНЯЯ ТЕНЬ — ПОД ЯЙЦОМ, А НЕ НА НЁМ */
    .egg-shadow{
        position:absolute;
        bottom:4px;               /* чуть ниже яйца */
        left:50%;
        transform:translateX(-50%);
        width:120px;
        height:30px;
        border-radius:50%;
        background:radial-gradient(ellipse at center,
                                   rgba(0,0,0,0.20) 0,
                                   rgba(0,0,0,0.08) 45%,
                                   transparent 75%);
        filter: blur(4px);
        z-index: 1;               /* под яйцом */
    }

    .egg.shake{
        animation:shake .25s ease;
    }
    @keyframes shake{
      0%{transform:translateX(0)}
      25%{transform:translateX(-6px)}
      50%{transform:translateX(5px)}
      75%{transform:translateX(-3px)}
      100%{transform:translateX(0)}
    }

    .counter{
        font-size:15px;
        font-weight:600;
        color:var(--purple);
        margin-top:6px;
    }
    .hint{
        font-size:12px;
        color:var(--text-soft);
    }

    /* Блок имени + кнопка */
    #nameBlock{
        margin-top:18px;
        background:var(--card-soft);
        padding:14px 14px 16px;
        border-radius:18px;
        display:none;
        box-shadow:0 10px 24px rgba(0,0,0,0.06);
        text-align:left;
    }
    #nameBlock label{
        font-size:13px;
        color:var(--text-soft);
        display:block;
        margin-bottom:6px;
    }
    #nameInput{
        width:100%;
        padding:8px 10px;
        background:#fdf2ff;
        border-radius:10px;
        border:1px solid rgba(216,180,254,0.9);
        color:#111827;
        outline:none;
        font-size:14px;
    }
    #nameInput:focus{
        border-color:var(--purple);
        box-shadow:0 0 0 2px rgba(217,70,239,0.25);
    }

    #saveNameBtn{
        margin-top:12px;
        padding:9px 22px;
        border:none;
        border-radius:999px;
        background:linear-gradient(135deg, #d946ef, #fb7185);
        font-size:14px;
        color:white;
        cursor:pointer;
        font-weight:600;
        display:block;
        margin-left:auto;
        margin-right:auto;
        box-shadow:0 8px 18px rgba(248,113,165,0.45);
    }
    #saveNameBtn:active{
        transform:scale(0.97);
        box-shadow:0 4px 10px rgba(248,113,165,0.35);
    }

    @media (max-width: 380px){
        .egg{
            width:150px;
            height:190px;
        }
    }
</style>
</head>
<body>

<div class="header">
    <div class="header-inner">
        <div class="badge">
            <span>Новое яйцо</span>
        </div>

        <h2>Твой друг ждёт рождения</h2>

        <div class="subtitle">
            <div>Нажми на яйцо 10 раз, чтобы вылупить питомца.</div>
            <div>Потом дай ему имя, и он появится на главной панели.</div>
        </div>
    </div>
</div>

<div class="page-card">
    <div class="egg-wrapper">
        <div id="egg" class="egg">
            <div class="egg-shine"></div>
        </div>
        <div class="egg-shadow"></div>
    </div>

    <div class="counter" id="counterText">)rawliteral";

    page += String(clickCount) + " / 10 кликов";

    page += R"rawliteral(</div>
    <div class="hint">Кликай по яйцу, оно начинает дрожать от нетерпения 💗</div>

    <div id="nameBlock">
        <label>Он вылупляется, придумай для него имя!</label>
        <input id="nameInput" type="text" maxlength="15" placeholder="ИМЯ">
        <button id="saveNameBtn">Вылупить!</button>
    </div>
</div>

<script>
let clicks = )rawliteral";

    page += String(clickCount);

    page += R"rawliteral(;

const egg = document.getElementById("egg");
const counterText = document.getElementById("counterText");
const nameBlock = document.getElementById("nameBlock");
const nameInput = document.getElementById("nameInput");
const saveNameBtn = document.getElementById("saveNameBtn");

egg.addEventListener("click", () => {
    egg.classList.remove("shake");
    void egg.offsetWidth;
    egg.classList.add("shake");

    fetch("/eggClick").then(r => r.json()).then(data => {
        clicks = data.clicks;
        counterText.textContent = clicks + " / 10 кликов";

        if (clicks >= 10) {
            nameBlock.style.display = "block";
        }
    });
});

saveNameBtn.onclick = () => {
    const name = nameInput.value.trim();
    if (!name) return;

    fetch("/saveName?name=" + encodeURIComponent(name))
      .then(() => {
        window.location.href = "/";
      });
};
</script>

</body>
</html>
)rawliteral";

    return page;
  }
};

Adafruit_SSD1306 display(128, 64, &Wire);

PetConfig petConfig;
const char *ssid = "U+Net0BBC";
const char *password = "7A87@4P598";
struct tm timeinfo;

class Animations
{
private:
  Adafruit_SSD1306 &display;
  static const unsigned char eatingFace_1[] PROGMEM;
  static const unsigned char eatingFace_2[] PROGMEM;
  static const unsigned char eatingFace_3[] PROGMEM;
  static const unsigned char eatingFace_4[] PROGMEM;
  static const unsigned char eatingFace_5[] PROGMEM;
  static const unsigned char enoght[] PROGMEM;
  static const unsigned char shower[] PROGMEM;

  static const unsigned char pettedFace[] PROGMEM;

public:
  Animations(Adafruit_SSD1306 &disp) : display(disp) {}

  void petted()
  {
    for (int index = 0; index < 2; index++)
    {
      if (index != 0)
        delay(200);
      display.clearDisplay();
      display.drawBitmap(STANDARD_SCREEN_OFFSET_X - 2, STANDARD_SCREEN_OFFSET_Y, this->pettedFace, 96, 48, SSD1306_WHITE);
      display.display();
      delay(200);
      display.clearDisplay();
      display.drawBitmap(STANDARD_SCREEN_OFFSET_X + 2, STANDARD_SCREEN_OFFSET_Y, this->pettedFace, 96, 48, SSD1306_WHITE);
      display.display();
    }
  }

  void eating()
  {
    for (int index = 0; index < 4; index++)
    {
      if (index != 0)
        delay(100);
      display.clearDisplay();
      display.drawBitmap(STANDARD_SCREEN_OFFSET_X, STANDARD_SCREEN_OFFSET_Y, this->eatingFace_1, 96, 48, SSD1306_WHITE);
      display.display();
      delay(100);
      display.clearDisplay();
      display.drawBitmap(STANDARD_SCREEN_OFFSET_X, STANDARD_SCREEN_OFFSET_Y, this->eatingFace_2, 96, 48, SSD1306_WHITE);
      display.display();
      delay(100);
      display.clearDisplay();
      display.drawBitmap(STANDARD_SCREEN_OFFSET_X, STANDARD_SCREEN_OFFSET_Y, this->eatingFace_3, 96, 48, SSD1306_WHITE);
      display.display();
      delay(100);
      display.clearDisplay();
      display.drawBitmap(STANDARD_SCREEN_OFFSET_X, STANDARD_SCREEN_OFFSET_Y, this->eatingFace_4, 96, 48, SSD1306_WHITE);
      display.display();
      delay(100);
      display.clearDisplay();
      display.drawBitmap(STANDARD_SCREEN_OFFSET_X, STANDARD_SCREEN_OFFSET_Y, this->eatingFace_5, 96, 48, SSD1306_WHITE);
      display.display();
    }
  }

  void enoughEating()
  {
    for (int index = 0; index < 2; index++)
    {
      if (index != 0)
        delay(200);
      display.clearDisplay();
      display.drawBitmap(STANDARD_SCREEN_OFFSET_X - 1, STANDARD_SCREEN_OFFSET_Y, this->enoght, 96, 48, SSD1306_WHITE);
      display.display();
      delay(200);
      display.clearDisplay();
      display.drawBitmap(STANDARD_SCREEN_OFFSET_X + 1, STANDARD_SCREEN_OFFSET_Y, this->enoght, 96, 48, SSD1306_WHITE);
      display.display();
    }
  }

  void showering()
  {
    for (int index = 0; index < 8; index++)
    {
      if (index != 0)
        delay(100);
      display.clearDisplay();
      display.drawBitmap(STANDARD_SCREEN_OFFSET_X - 1, STANDARD_SCREEN_OFFSET_Y, this->enoght, 96, 48, SSD1306_WHITE);
      display.drawBitmap(0 + index * 10, STANDARD_SCREEN_OFFSET_Y, this->shower, 96, 48, SSD1306_WHITE);
      display.display();
    }
    for (int index = 0; index < 8; index++)
    {
      if (index != 0)
        delay(100);
      display.clearDisplay();
      display.drawBitmap(STANDARD_SCREEN_OFFSET_X - 1, STANDARD_SCREEN_OFFSET_Y, this->enoght, 96, 48, SSD1306_WHITE);
      display.drawBitmap(70 - index * 10, STANDARD_SCREEN_OFFSET_Y, this->shower, 96, 48, SSD1306_WHITE);
      display.display();
    }
  }
};

Animations animation(display);
Factors factors = {50, 50, 50, 50};
unsigned int claculateOverall(Factors f)
{
  return (f.attention + f.clean + f.hunger + f.petting) / 4;
}
int eggClicks = 0;
const unsigned char openEyes[] PROGMEM = {
    0x00, 0x00, 0x00, 0x00, 0x00, 0x00, 0x00, 0x00, 0x00, 0x00, 0x00, 0x00, 0x00, 0x00, 0x00, 0x00,
    0x00, 0x00, 0x00, 0x00, 0x00, 0x00, 0x00, 0x00, 0x00, 0x00, 0x00, 0x00, 0x00, 0x00, 0x00, 0x00,
    0x00, 0x00, 0x00, 0x00, 0x00, 0x00, 0x00, 0x00, 0x00, 0x00, 0x00, 0x00, 0x00, 0x00, 0x00, 0x00,
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    0x00, 0x00, 0x00, 0x00, 0x00, 0x00, 0x00, 0x00, 0x00, 0x00, 0x00, 0x00, 0x00, 0x00, 0x00, 0x00};

const unsigned char blinkedEyes[] PROGMEM = {
    0x00, 0x00, 0x00, 0x00, 0x00, 0x00, 0x00, 0x00, 0x00, 0x00, 0x00, 0x00, 0x00, 0x00, 0x00, 0x00,
    0x00, 0x00, 0x00, 0x00, 0x00, 0x00, 0x00, 0x00, 0x00, 0x00, 0x00, 0x00, 0x00, 0x00, 0x00, 0x00,
    0x00, 0x00, 0x00, 0x00, 0x00, 0x00, 0x00, 0x00, 0x00, 0x00, 0x00, 0x00, 0x00, 0x00, 0x00, 0x00,
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    0x00, 0x00, 0x00, 0x00, 0x00, 0x00, 0x00, 0x00, 0x00, 0x00, 0x00, 0x00, 0x00, 0x00, 0x00, 0x00};

const unsigned char tiredBlinkedEyes[] PROGMEM = {
    0x00, 0x00, 0x00, 0x00, 0x00, 0x00, 0x00, 0x00, 0x00, 0x00, 0x00, 0x00, 0x00, 0x00, 0x00, 0x00,
    0x00, 0x00, 0x00, 0x00, 0x00, 0x00, 0x00, 0x00, 0x00, 0x00, 0x00, 0x00, 0x00, 0x00, 0x00, 0x00,
    0x00, 0x00, 0x00, 0x00, 0x00, 0x00, 0x00, 0x00, 0x00, 0x00, 0x00, 0x00, 0x00, 0x00, 0x00, 0x00,
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    0x00, 0x00, 0x00, 0x00, 0x00, 0x00, 0x00, 0x00, 0x00, 0x00, 0x00, 0x00, 0x00, 0x00, 0x00, 0x00};

const unsigned char tiredOpenEyes[] PROGMEM = {
    0x00, 0x00, 0x00, 0x00, 0x00, 0x00, 0x00, 0x00, 0x00, 0x00, 0x00, 0x00, 0x00, 0x00, 0x00, 0x00,
    0x00, 0x00, 0x00, 0x00, 0x00, 0x00, 0x00, 0x00, 0x00, 0x00, 0x00, 0x00, 0x00, 0x00, 0x00, 0x00,
    0x00, 0x00, 0x00, 0x00, 0x00, 0x00, 0x00, 0x00, 0x00, 0x00, 0x00, 0x00, 0x00, 0x00, 0x00, 0x00,
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    0x00, 0x00, 0x00, 0x00, 0x00, 0x00, 0x00, 0x00, 0x00, 0x00, 0x00, 0x00, 0x00, 0x00, 0x00, 0x00};

const unsigned char Animations::enoght[] PROGMEM = {
    0x00, 0x00, 0x00, 0x00, 0x00, 0x00, 0x00, 0x00, 0x00, 0x00, 0x00, 0x00, 0x00, 0x00, 0x00, 0x00,
    0x00, 0x00, 0x00, 0x00, 0x00, 0x00, 0x00, 0x00, 0x00, 0x00, 0x00, 0x00, 0x00, 0x00, 0x00, 0x00,
    0x00, 0x00, 0x00, 0x00, 0x00, 0x00, 0x00, 0x00, 0x00, 0x00, 0x00, 0x00, 0x00, 0x00, 0x00, 0x00,
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    0x00, 0x00, 0x00, 0x00, 0x00, 0x00, 0x00, 0x00, 0x00, 0x00, 0x00, 0x00, 0x00, 0x00, 0x00, 0x00};

const unsigned char Animations::eatingFace_1[] PROGMEM = {
    0x00, 0x00, 0x00, 0x00, 0x00, 0x00, 0x00, 0x00, 0x00, 0x00, 0x00, 0x00, 0x00, 0x00, 0x00, 0x00,
    0x00, 0x00, 0x00, 0x00, 0x00, 0x00, 0x00, 0x00, 0x00, 0x00, 0x00, 0x00, 0x00, 0x00, 0x00, 0x00,
    0x00, 0x00, 0x00, 0x00, 0x00, 0x00, 0x00, 0x00, 0x00, 0x00, 0x00, 0x00, 0x00, 0x00, 0x00, 0x00,
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    0x00, 0x00, 0x00, 0x00, 0x00, 0x00, 0x00, 0x00, 0x00, 0x00, 0x00, 0x00, 0x00, 0x00, 0x00, 0x00};
// '2', 96x48px
const unsigned char Animations::eatingFace_2[] PROGMEM = {
    0x00, 0x00, 0x00, 0x00, 0x00, 0x00, 0x00, 0x00, 0x00, 0x00, 0x00, 0x00, 0x00, 0x00, 0x00, 0x00,
    0x00, 0x00, 0x00, 0x00, 0x00, 0x00, 0x00, 0x00, 0x00, 0x7f, 0x80, 0x00, 0x00, 0x00, 0x00, 0x00,
    0x00, 0x01, 0xfe, 0x00, 0x01, 0xff, 0xff, 0x00, 0x00, 0x00, 0x00, 0x00, 0x00, 0xff, 0xff, 0x80,
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    0x00, 0x00, 0x00, 0x00, 0x00, 0x00, 0x00, 0x00, 0x00, 0x00, 0x00, 0x00, 0x00, 0x00, 0x00, 0x00};
// '3', 96x48px
const unsigned char Animations::eatingFace_3[] PROGMEM = {
    0x00, 0x00, 0x00, 0x00, 0x00, 0x00, 0x00, 0x00, 0x00, 0x00, 0x00, 0x00, 0x00, 0x00, 0x00, 0x00,
    0x00, 0x00, 0x00, 0x00, 0x00, 0x00, 0x00, 0x00, 0x00, 0xff, 0xf0, 0x00, 0x00, 0x00, 0x00, 0x00,
    0x00, 0x0f, 0xff, 0x00, 0x01, 0xff, 0xff, 0xc0, 0x00, 0x00, 0x00, 0x00, 0x03, 0xff, 0xff, 0x80,
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    0x00, 0x00, 0x00, 0x00, 0x00, 0x00, 0x00, 0x00, 0x00, 0x00, 0x00, 0x00, 0x00, 0x00, 0x00, 0x00};
// '4', 96x48px
const unsigned char Animations::eatingFace_4[] PROGMEM = {
    0x00, 0x00, 0x00, 0x00, 0x00, 0x00, 0x00, 0x00, 0x00, 0x00, 0x00, 0x00, 0x00, 0x00, 0x00, 0x00,
    0x00, 0x00, 0x00, 0x00, 0x00, 0x00, 0x00, 0x00, 0x01, 0xff, 0xf0, 0x00, 0x00, 0x00, 0x00, 0x00,
    0x00, 0x0f, 0xff, 0x80, 0x03, 0xff, 0xff, 0xc0, 0x00, 0x00, 0x00, 0x00, 0x03, 0xff, 0xff, 0xc0,
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    0x00, 0x00, 0x00, 0x00, 0x00, 0x00, 0x00, 0x00, 0x00, 0x00, 0x00, 0x00, 0x00, 0x00, 0x00, 0x00};
// '5', 96x48px
const unsigned char Animations::eatingFace_5[] PROGMEM = {
    0x00, 0x00, 0x00, 0x00, 0x00, 0x00, 0x00, 0x00, 0x00, 0x00, 0x00, 0x00, 0x00, 0x00, 0x00, 0x00,
    0x00, 0x00, 0x00, 0x00, 0x00, 0x00, 0x00, 0x00, 0x00, 0x7f, 0xc0, 0x00, 0x00, 0x00, 0x00, 0x00,
    0x00, 0x03, 0xfe, 0x00, 0x01, 0xff, 0xfe, 0x00, 0x00, 0x00, 0x00, 0x00, 0x00, 0x7f, 0xff, 0x80,
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    0x00, 0x00, 0x00, 0x00, 0x00, 0x00, 0x00, 0x00, 0x00, 0x00, 0x00, 0x00, 0x00, 0x00, 0x00, 0x00};

const unsigned char Animations::pettedFace[] PROGMEM = {
    0x00, 0x00, 0x00, 0x00, 0x00, 0x00, 0x00, 0x00, 0x00, 0x00, 0x00, 0x00, 0x00, 0x00, 0x00, 0x00,
    0x00, 0x00, 0x00, 0x00, 0x00, 0x00, 0x00, 0x00, 0x00, 0x00, 0x00, 0x00, 0x00, 0x00, 0x00, 0x00,
    0x00, 0x00, 0x00, 0x00, 0x00, 0x00, 0x00, 0x00, 0x00, 0x00, 0x00, 0x00, 0x00, 0x00, 0x00, 0x00,
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    0x00, 0x00, 0x00, 0x00, 0x00, 0x00, 0x00, 0x00, 0x00, 0x00, 0x00, 0x00, 0x00, 0x00, 0x00, 0x00};

const unsigned char Animations::shower[] PROGMEM = {
    0x00, 0x00, 0x00, 0x00, 0x00, 0x00, 0x00, 0x00, 0x00, 0x00, 0x00, 0x00, 0x00, 0x00, 0x00, 0x00,
    0x00, 0x00, 0x00, 0x00, 0x00, 0x00, 0x00, 0x00, 0x00, 0x00, 0x00, 0x00, 0x00, 0x00, 0x00, 0x00,
    0x00, 0x00, 0x00, 0x00, 0x00, 0x00, 0x00, 0x00, 0x00, 0x00, 0x00, 0x00, 0x00, 0x00, 0x00, 0x00,
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    0x00, 0x00, 0x00, 0x00, 0x00, 0x00, 0x00, 0x00, 0x00, 0x00, 0x00, 0x00, 0x00, 0x00, 0x00, 0x00};

const unsigned char egg[] PROGMEM = {
    0x00, 0x00, 0x00, 0x00, 0x00, 0x00, 0x00, 0x00, 0x00, 0x00, 0x00, 0x00, 0x00, 0x00, 0x00, 0x00,
    0x00, 0x00, 0x00, 0x00, 0x00, 0x00, 0x00, 0x00, 0x00, 0x00, 0x00, 0x00, 0x00, 0x00, 0x00, 0x00,
    0x00, 0x00, 0x00, 0x00, 0x00, 0x00, 0x00, 0x00, 0x00, 0x00, 0x00, 0x00, 0x00, 0x00, 0x00, 0x00,
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    0x00, 0x00, 0x00, 0x00, 0x00, 0x00, 0x00, 0x00, 0x00, 0x00, 0x00, 0x00, 0x00, 0x00, 0x00, 0x00};
// '44', 96x48px
const unsigned char openEgg[] PROGMEM = {
    0x00, 0x00, 0x00, 0x00, 0x00, 0x00, 0x00, 0x00, 0x00, 0x00, 0x00, 0x00, 0x00, 0x00, 0x00, 0x00,
    0x00, 0x00, 0x00, 0x00, 0x00, 0x00, 0x00, 0x00, 0x00, 0x00, 0x00, 0x00, 0x00, 0x00, 0x00, 0x00,
    0x00, 0x00, 0x00, 0x00, 0x00, 0x00, 0x00, 0x00, 0x00, 0x00, 0x00, 0x00, 0x00, 0x00, 0x00, 0x00,
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    0x00, 0x00, 0x00, 0x00, 0x00, 0x00, 0x00, 0x00, 0x00, 0x00, 0x00, 0x00, 0x00, 0x00, 0x00, 0x00};

const unsigned char crackEgg[] PROGMEM = {
    0x00, 0x00, 0x00, 0x00, 0x00, 0x00, 0x00, 0x00, 0x00, 0x00, 0x00, 0x00, 0x00, 0x00, 0x00, 0x00,
    0x00, 0x00, 0x00, 0x00, 0x00, 0x00, 0x00, 0x00, 0x00, 0x00, 0x00, 0x00, 0x00, 0x00, 0x00, 0x00,
    0x00, 0x00, 0x00, 0x00, 0x00, 0x00, 0x00, 0x00, 0x00, 0x00, 0x00, 0x00, 0x00, 0x00, 0x00, 0x00,
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    0x00, 0x00, 0x00, 0x00, 0x00, 0x00, 0x00, 0x00, 0x00, 0x00, 0x00, 0x00, 0x00, 0x00, 0x00, 0x00};

unsigned long blinkTimer = 0;
unsigned long factorTimer = 0;
uint8_t blinkState = 0;
bool isBlinking = false;

WebServer server(80);
Panel panel(&factors, petConfig.name);

//
void _displayFactors(Factors f)
{
  Serial.println();
  Serial.println("STATUS: ");
  Serial.printf("OVERALL: %u%%\n", claculateOverall(f));

  Serial.printf("Hunger: %u%%\n", f.hunger);
  Serial.printf("Petting: %u%%\n", f.petting);
  Serial.printf("Attention: %u%%\n", f.attention);
  Serial.printf("Clean: %u%%\n", f.clean);
}

void HandleFactorsDecrease(Factors *f)
{
  unsigned long now = millis();
  if (now - factorTimer >= FACTOR_DECREASE_PERIOD)
  {
    f->attention *= ATTENTION_DECREASE_RATE;
    f->clean *= CLEAN_DECREASE_RATE;
    f->hunger *= HUNGER_DECREASE_RATE;
    f->petting *= PETTING_DECREASE_RATE;
    factorTimer = now;
    saveFactors(*f);
  }
}

void increaseFactor(unsigned int *factor, float rate)
{
  if (*factor >= 100)
    return;

  float newValue = *factor + (rate);
  factors.attention += 10;

  if (factors.attention > 100.0f)
    factors.attention = 100.0f;

  if (newValue > 100.0f)
    newValue = 100.0f;

  *factor = (unsigned int)newValue;
  saveFactors(factors);
}

void APsetup()
{
  WiFi.disconnect(true, true);
  delay(500);

  WiFi.mode(WIFI_AP);
  WiFi.softAP("Raf", nullptr, 1, 0);
  WiFi.setTxPower(WIFI_POWER_19_5dBm);

  Serial.println("[AP] Started");
  Serial.print("[AP] IP: ");
  Serial.println(WiFi.softAPIP());

  // ----- ROOT: яйцо или панель в зависимости от hatched -----
  server.on("/", []()
            {
              if (!petConfig.hatched)
              {
                // Яйцо и кликер
                server.send(200, "text/html; charset=UTF-8", panel.renderEgg(eggClicks));
              }
              else
              {
                // Уже вылупился — обычная панель
                server.send(200, "text/html; charset=UTF-8", panel.render());
              } });

  // ----- Клик по яйцу -----
  server.on("/eggClick", []()
            {
              eggClicks++;
              if (eggClicks > 10)
                eggClicks = 10;

              String json = "{\"clicks\":" + String(eggClicks) + "}";
              server.send(200, "application/json; charset=UTF-8", json); });

  // ----- Сохранение имени и пометка, что вылупился -----
  server.on("/saveName", []()
            {
              if (server.hasArg("name"))
              {
                String name = server.arg("name");
                name.trim();
                if (name.length() > 0 && name.length() < 16)
                {
                  name.toCharArray(petConfig.name, 16);
                  petConfig.hatched = true;

                  saveConfig(petConfig);
                  panel.setName(petConfig.name);

                  Serial.print("[EGG] Saved name: ");
                  Serial.println(name);
                }
              }
              // фронтенд потом сделает window.location.href = "/"
              server.send(200, "text/plain", "OK"); });

  // ----- API для уже вылупленного тамагочи -----
  server.on("/status", []()
            {
              String json = "{";
              json += "\"hunger\":" + String(factors.hunger) + ",";
              json += "\"petting\":" + String(factors.petting) + ",";
              json += "\"attention\":" + String(factors.attention) + ",";
              json += "\"clean\":" + String(factors.clean);
              json += "}";
              server.send(200, "application/json; charset=UTF-8", json); });

  server.on("/feed", []()
            {
              if (factors.hunger < 100)
                animation.eating();
              else
                animation.enoughEating();

              increaseFactor(&factors.hunger, 25);
              saveFactors(factors);
              server.send(200, "text/plain; charset=UTF-8", "OK"); });

  server.on("/clean", []()
            {
              if (factors.clean < 100)
                animation.showering();
              else
                animation.enoughEating();

              increaseFactor(&factors.clean, 25);
              saveFactors(factors);
              server.send(200, "text/plain; charset=UTF-8", "OK"); });

  server.begin();
  Serial.println("HTTP server started.");
}

void HandleBlinking()
{
  unsigned long now = millis();

  switch (blinkState)
  {
  case 0:

    if (now - blinkTimer >= BLINK_PERIOD)
    {
      blinkState = 1;
      blinkTimer = now;
      isBlinking = true;
    }
    break;

  case 1:

    if (now - blinkTimer >= BLINK_TIME)
    {
      blinkState = 2;
      blinkTimer = now;
      isBlinking = false;
    }
    break;

  case 2:

    if (now - blinkTimer >= BLINK_TIME)
    {
      blinkState = 3;
      blinkTimer = now;
      isBlinking = true;
    }
    break;

  case 3:
    // Вторая закрытая фаза
    if (now - blinkTimer >= BLINK_TIME)
    {
      blinkState = 4;
      blinkTimer = now;
      isBlinking = false;
    }
    break;

  case 4:

    if (now - blinkTimer >= BLINK_PERIOD)
    {
      blinkState = 1;
      blinkTimer = now;
      isBlinking = true;
    }
    break;
  }
}

bool isPressed()
{
  int touch = digitalRead(TOUCH_PIN);

  if (touch == 1)
    return true;
  else if (touch == 0)
    return false;
}

//

void setup()
{

  Serial.begin(115200);

  clearEEPROM(); // tmp

  delay(1000);
  Serial.println("BOOTING...");
  EEPROM.begin(EEPROM_SIZE);
  Wire.begin(SDA_PIN, SCL_PIN);
  pinMode(TOUCH_PIN, INPUT);

  if (!display.begin(SSD1306_SWITCHCAPVCC, 0x3C))
  {
    for (;;)
      ;
  }

  blinkTimer = millis();
  blinkState = 0;
  isBlinking = false;

  if (hasSavedFactors())
  {
    loadFactors(factors);
    Serial.println("Loaded from memory!");
  }
  else
  {
    Serial.println("No saved data — using defaults!");
    factors = {80, 80, 80, 80};
    saveFactors(factors);
  }

  display.clearDisplay();
  display.setTextSize(2);
  display.setTextColor(SSD1306_WHITE);
  display.setCursor(STANDARD_SCREEN_OFFSET_X, STANDARD_SCREEN_OFFSET_Y + 20);
  display.println("LOADING");
  display.display();

  // --- Загружаем конфиг тамагочи (имя + флаг вылупления) ---
  if (hasSavedConfig())
  {
    loadConfig(petConfig);
    Serial.printf("Config: name='%s', hatched=%d\n", petConfig.name, petConfig.hatched);
  }
  else
  {
    Serial.println("No pet config — creating new egg.");
    memset(&petConfig, 0, sizeof(petConfig));
    strncpy(petConfig.name, "Raf", sizeof(petConfig.name) - 1);
    petConfig.hatched = false;
    saveConfig(petConfig);
  }

  panel.setName(petConfig.name);
  randomSeed(esp_random());
  APsetup();
}

void loop()
{
  display.clearDisplay();

  server.handleClient(); // Сначала обслуживаем веб

  // Пока яйцо не вылупилось — отдельная анимация
  if (!petConfig.hatched)
  {
    display.clearDisplay();
    static unsigned long eggTimer = 0;
    static uint8_t eggPhase = 0;

    unsigned long now = millis();
    if (now - eggTimer >= 280)
    {
      eggTimer = now;
      eggPhase = (eggPhase + 1) % 4;
    }

    int y = STANDARD_SCREEN_OFFSET_Y + 8 + (eggPhase % 2 ? 2 : 0);

    int cx = STANDARD_SCREEN_OFFSET_X + 48; // центр яйца
    int cy = y + 24;

    // Простая «яйцеобразная» фигура
    if (eggClicks <= 5)
      display.drawBitmap(STANDARD_SCREEN_OFFSET_X + random(-1, 2) * eggClicks, STANDARD_SCREEN_OFFSET_Y, egg, 96, 48, SSD1306_WHITE);
    if (eggClicks > 5 && eggClicks < 10)
      display.drawBitmap(STANDARD_SCREEN_OFFSET_X + random(-1, 2) * eggClicks, STANDARD_SCREEN_OFFSET_Y, crackEgg, 96, 48, SSD1306_WHITE);
    if (eggClicks >= 10)
      display.drawBitmap(STANDARD_SCREEN_OFFSET_X, STANDARD_SCREEN_OFFSET_Y, openEgg, 96, 48, SSD1306_WHITE);

    display.display();
    return; // не переходим к обычной логике, пока не вылупилось
  }

  // Обычное поведение после вылупления
  HandleBlinking();
  HandleFactorsDecrease(&factors);

  _displayFactors(factors); // если хочешь, можешь убрать

  if (isPressed())
  {
    animation.petted();
    increaseFactor(&factors.petting, 5);
  }
  else if (isBlinking)
  {
    if (claculateOverall(factors) > 30)
      display.drawBitmap(STANDARD_SCREEN_OFFSET_X, STANDARD_SCREEN_OFFSET_Y, blinkedEyes, 96, 48, SSD1306_WHITE);
    else
      display.drawBitmap(STANDARD_SCREEN_OFFSET_X, STANDARD_SCREEN_OFFSET_Y, tiredBlinkedEyes, 96, 48, SSD1306_WHITE);
  }
  else
  {
    if (claculateOverall(factors) > 30)
      display.drawBitmap(STANDARD_SCREEN_OFFSET_X, STANDARD_SCREEN_OFFSET_Y, openEyes, 96, 48, SSD1306_WHITE);
    else
      display.drawBitmap(STANDARD_SCREEN_OFFSET_X, STANDARD_SCREEN_OFFSET_Y, tiredOpenEyes, 96, 48, SSD1306_WHITE);
  }

  display.display();
}
